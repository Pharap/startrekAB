#include <Arduino.h>
#include <Sprites.h>
#include <Print.h>
#include "Font3x5.h"

#define FONT3X5_WIDTH 3
#define FONT3X5_HEIGHT 6

const uint8_t PROGMEM font_images[] = {
3, 8,

0x00, 0x00, 0x00,
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0x19, 0x15, 0x13, // Z
};


Font3x5::Font3x5(uint8_t lineSpacing) {

  _lineHeight = lineSpacing;
  _letterSpacing = 1;

  _cursorX = _cursorY = _baseX = 0;
  _textColor = 1;

}

size_t Font3x5::write(uint8_t c) {

  if (c == '\n')      { _cursorX = _baseX; _cursorY += _lineHeight; }
  else {

    printChar(c, _cursorX, _cursorY);
    _cursorX += FONT3X5_WIDTH + _letterSpacing;

  }

  return 1;

}

void Font3x5::printChar(const char c, const int8_t x, int8_t y) {

  int8_t idx = -1;

  ++y;

  idx = c - 32;

  if (idx > -1) {
    
    if (_textColor == WHITE) {
      Sprites::drawSelfMasked(x, y, font_images, idx);
    }
    else {
      Sprites::drawErase(x, y, font_images, idx);
    }

  }

}

void Font3x5::setCursor(const int8_t x, const int8_t y) {
  _cursorX = _baseX = x;
  _cursorY = y;
}

void Font3x5::setTextColor(const uint8_t color){
  _textColor = color;
}

void Font3x5::setHeight(const uint8_t color){
  _lineHeight = color;
}
